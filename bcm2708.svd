# RasbperryPi register map
File version: 1
Registers are 32-bit, read-write, reset 0x0 unless marked. A register's access mark holds for its fields unless they carry their own. Offsets are from the block's base; [hi:lo] are bit positions; {n}, {i} and the like mark numbered series.

## CCP2TX — Derived from ccp2tx_a0.h apb_id: 0x63637032
Base 0x7E001000
0x00 TC reset not defined
  [31:0] data
0x04 TS reset not defined
  [31:0] data
0x08 TPC reset not defined
  [31:0] data
0x0C TSC reset not defined
  [31:0] data
0x10 TIC reset not defined
  [31:0] data
0x14 TTC reset not defined
  [31:0] data
0x18 TBA reset not defined
  [31:0] data
0x1C TDL reset not defined
  [31:0] data
0x20 TD reset not defined
  [31:0] data

## CD — Derived from cdp.h apb_id: 0x43445000
Base 0x1820B000
Same registers: ST 0x7E003000
0x00 CS
  [31:0] data

## CMI — Derived from clkman_image.h password: 0x5A000000 apb_id: 0x00636D69
Base 0x7E802000
0x00 CAM0 6-bit
  [5:4] RX1SRC, [3:2] RX0SRC, [1:0] HSSRC
0x04 CAM1 10-bit
  [2n+3:2n+2] RX{n}SRC (n=0..3), [1:0] HSSRC
0x08 CAMTEST 5-bit
  [4] ENAB, [3:0] SRC
0x10 USBCTL 7-bit reset 0x40
  [6] GATE, [5:0] _

## CPG — Derived from cpg.h apb_id: 0x67706320
Base 0x7E211000
0x00 Config reset not defined
  [31:0] data
0x04 IntStatus reset not defined
  [31:0] data
0x08 Trigger 2-bit reset not defined
  [1:0] data
{0x10+4i} Param{i} reset not defined (i=0..3)
  [31:0] data
{0x40+4i} Debug{i} reset not defined (i=0..3)
  [31:0] data

## CPI — Derived from cpi.h apb_id: 0x20637069
Base 0x7E800000
0x00 CPIS reset not defined
  [31:0] data

## CS — Derived from csi2.h apb_id: 0x43534932
Base 0x7E802000
0x00 RC
  [31:0] data

## DPI — Derived from dpi.h apb_id: 0x44504920
Base 0x7E208000
0x00 C 16-bit
  [15:0] data

## DSI0 — Derived from dsi.h apb_id: 0x00647369
Base 0x7E209000
0x00 CTRL 3-bit
  [2] CTRL2, [1] CTRL1, [0] CTRL0
0x04 CMD_PKTC
  [31:0] data
0x08 CMD_PKTH
  [31:0] data
0x0C RX1_PKTH ro reset not defined
  [31:0] data
0x10 RX2_PKTH ro reset not defined
  [31:0] data
0x14 CMD_DATAF 8-bit reset not defined
  [7:0] data
0x18 DISP0_CTR
  [31:0] data
0x1C DISP1_CTR
  [31:0] data
0x20 PIX_FIFO reset not defined
  [31:0] data
0x24 INT_STAT reset not defined
  [31:0] data
0x28 INT_EN 28-bit
  [27:0] data
0x2C STAT reset not defined
  [31:0] data
0x30 HSTX_TO_C 24-bit
  [23:0] data
0x34 LPRX_TO_C
  [31:0] data
0x38 TA_TO_CNT
  [31:0] data
0x3C PR_TO_CNT
  [31:0] data
0x40 PHYC 18-bit
  [17:12] dsi_esc_lpdt, [11] _, [10] txhsclk_cont_sync, [9] txulps_clk_sync, [8] clane_hsen_sync, [7] _, [6] txulpshs_1_sync, [5] dlane_hsen_1_sync, [3] _, [2] forcehsstop_sync, [1] txulpshs_0_sync, [0] dlane_hsen_0_sync
0x44 HS_CLT0
  [31:0] data
0x48 HS_CLT1 10-bit
  [9:0] data
0x4C HS_CLT2 10-bit
  [9:0] data
{0x44+4i} HS_DLT{i} 10-bit (i=3..5)
  [9:0] data
0x5C LP_DLT6 10-bit
  [9:0] data
0x60 LP_DLT7 10-bit
  [9:0] data
0x64 PHY_AFEC0 8-bit
  [7:0] data
0x68 PHY_AFEC1
  [31:0] data
0x6C TST_SEL 8-bit
  [7:0] data
0x70 TST_MON 8-bit
  [7:0] data

## DSI1 — Derived from dsi4.h apb_id: 0x64736934
Base 0x7E700000
0x00 CTRL
  [31:0] data
0x04 TXPKT1_C
  [31:0] data
0x08 TXPKT1_H
  [31:0] data
0x0C TXPKT2_C
  [31:0] data
0x10 TXPKT2_H
  [31:0] data
0x14 RXPKT1_H ro reset not defined
  [31:0] data
0x18 RXPKT2_H ro reset not defined
  [31:0] data
0x1C TXPKT_CMD_FIFO 8-bit reset not defined
  [7:0] data
0x20 TXPKT_PIXD_FIFO
  [31:0] data
0x24 RXPKT_FIFO
  [31:0] data
0x28 DISP0_CTRL reset not defined
  [31:0] data
0x2C DISP1_CTRL reset not defined
  [31:0] data
0x30 INT_STAT reset not defined
  [31:0] data
0x34 INT_EN 28-bit
  [27:0] data
0x38 STAT reset not defined
  [31:0] data
0x3C HSTX_TO_CNT 24-bit
  [23:0] data
0x40 LPRX_TO_CNT
  [31:0] data
0x44 TA_TO_CNT
  [31:0] data
0x48 PR_TO_CNT
  [31:0] data
0x4C PHYC
  [31:0] data
{0x50+4i} HS_CLT{i} (i=0..2)
  [31:0] data
{0x50+4i} HS_DLT{i} (i=3..5)
  [31:0] data
0x68 LP_DLT6
  [31:0] data
0x6C LP_DLT7
  [31:0] data
0x70 PHY_AFEC0
  [31:0] data
0x74 PHY_AFEC1
  [31:0] data
0x78 TST_SEL
  [31:0] data
0x7C TST_MON
  [31:0] data
