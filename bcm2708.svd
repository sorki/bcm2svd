# RasbperryPi register map
File version: 1
broadcom/bcm2708_chip/*.h based SVD
Registers are 32-bit, read-write, reset 0x0 unless marked. A register's access mark holds for its fields unless they carry their own. Offsets are from the block's base; lines under a group give offsets from that group; [hi:lo] are bit positions; {n}, {i} and the like mark numbered series; 'fields as' and 'values as' point back to an identical list; <NAME> marks a mode.

## Memory map
0x1820B000 CD — Derived from cdp.h apb_id: 0x43445000
0x18E00000 TH — Derived from thread_ctrl.h apb_id: 0x74687265
0x7E000000 MS — Derived from multicore_sync.h apb_id: 0x4D554C54
0x7E001000 CCP2TX — Derived from ccp2tx.h apb_id: 0x63637032
0x7E001000 CCP2TX — Derived from ccp2tx_a0.h apb_id: 0x63637032
0x7E002000 IC0 — Derived from intctrl0.h apb_id: 0x494E5445
0x7E002800 IC1 — Derived from intctrl1.h apb_id: 0x494E5445
0x7E003000 ST — Derived from timer.h
0x7E004000 TXP — Derived from txp.h apb_id: 0x20763374
0x7E005000 JP — Derived from jpeg_top.h apb_id: 0x4A504547
0x7E006000 MPHI — Derived from mphi.h apb_id: 0x6D706869
{0x7E007000+0x100*n} DMA{n} (n=0..7) — Derived from axi_dma{n}.h
{0x7E007000+0x100*n} DMA{n} (n=7..14) — Derived from axi_dma_lite{n}.h
0x7E007FE0 DMA — Derived from axi_dma_top.h
0x7E008000 NU — Derived from nexus_uba.h
0x7E009000 SYSAC — Derived from system_arbiter_ctrl.h apb_id: 0x4152424D
0x7E009800 APERF0 — Derived from axi_performance0.h apb_id: 0x41584950
0x7E00A000 ASB — Derived from apb_async_bridge_ctrl.h apb_id: 0x62726467
0x7E100000 PM — Derived from cpr_powman.h password: 0x5A000000 apb_id: 0x0000706D
0x7E100000 PM — Derived from cpr_powman_a0.h password: 0x5A000000 apb_id: 0x0000706D
0x7E101000 CM — Derived from cpr_clkman.h password: 0x5A000000 apb_id: 0x0000636D
0x7E102000 A2W — Derived from cpr_apb2wtap.h password: 0x5A000000 apb_id: 0x00613277
0x7E102000 A2W — Derived from cpr_apb2wtap_a0.h password: 0x5A000000 apb_id: 0x00613277
0x7E104000 RNG — Derived from rng.h apb_id: 0x20726E67
0x7E104000 RNG — Derived from rng_a0.h apb_id: 0x20726E67
0x7E200000 GP — Derived from gpio.h apb_id: 0x6770696F
0x7E201000 UART — Derived from uart.h
0x7E202000 SH — Derived from sdhost.h
0x7E203000 PCM — Derived from pcm.h
0x7E204000 SPI — Derived from spi_master.h
0x7E205000 I2C0 — Derived from i2c0.h
0x7E206000 PIXELVALVE0 — Derived from pixel_valve0.h apb_id: 0x70697876
0x7E207000 PIXELVALVE1 — Derived from pixel_valve1.h apb_id: 0x70697876
0x7E208000 DPI — Derived from dpi.h apb_id: 0x44504920
0x7E209000 DSI0 — Derived from dsi.h apb_id: 0x00647369
0x7E20B000 TB — Derived from testbus.h
0x7E20B700 FPGA_MB — Derived from fpga_microblaze.h
0x7E20C000 PWM — Derived from pwm.h apb_id: 0x70776D30
0x7E20D000 PRM — Derived from perfmon.h
0x7E20E000 TE — Derived from tectl.h apb_id: 0x00746563
0x7E20E000 TE — Derived from tectl_a0.h apb_id: 0x00746563
0x7E20F000 OTP — Derived from otp.h apb_id: 0x206F7470
0x7E210000 SLIM — Derived from slimbus.h apb_id: 0x736C696D
0x7E210000 SLIM — Derived from slimbus_a0.h apb_id: 0x736C696D
0x7E211000 CPG — Derived from cpg.h apb_id: 0x67706320
0x7E212000 TS — Derived from tempsens.h apb_id: 0x7473656E
0x7E214000 I2C_SPI_SLV — Derived from i2c_spi_slv.h apb_id: 0x73506783
0x7E240000 AVE_OUT — Derived from ave_out.h apb_id: 0x61766538
0x7E300000 EMMC — Derived from emmc.h
0x7E400000 SCALER — Derived from hvs.h apb_id: 0x64647276
0x7E600000 SMI — Derived from smi.h apb_id: 0x534D4958
0x7E700000 DSI1 — Derived from dsi4.h apb_id: 0x64736934
0x7E800000 CAM0 — Derived from cam0.h apb_id: 0x7563616D
0x7E800000 CAM0 — Derived from cam0_a0.h apb_id: 0x7563616D
0x7E800000 CPI — Derived from cpi.h apb_id: 0x20637069
0x7E801000 CAM1 — Derived from cam1.h apb_id: 0x7563616D
0x7E801000 CAM1 — Derived from cam1_a0.h apb_id: 0x7563616D
0x7E801000 CCP — Derived from camccp.h apb_id: 0x63637032
0x7E802000 CMI — Derived from clkman_image.h password: 0x5A000000 apb_id: 0x00636D69
0x7E802000 CS — Derived from csi2.h apb_id: 0x43534932
0x7E804000 I2C1 — Derived from i2c1.h
0x7E805000 I2C2 — Derived from i2c2.h
0x7E806000 VEC — Derived from vec.h
0x7E807000 PIXELVALVE2 — Derived from pixel_valve2.h apb_id: 0x70697876
0x7E808000 HD — Derived from hdmi.h apb_id: 0x48444D49
0x7E809000 HDCP — Derived from hdcp.h apb_id: 0x48444350
0x7E80A000 ACR — Derived from apb_arbiter_control.h apb_id: 0x61726272
0x7E80A000 PIARBCTL — Derived from peri_image_arb_ctrl.h
0x7E902000 HDMI — Derived from hdmicore.h
0x7E910000 AVE_IN — Derived from ave_in.h apb_id: 0x61766530
0x7E980000 USB — Derived from usb.h apb_id: 0x75736230
0x7EA00000 ISP — Derived from isp.h apb_id: 0x20697370
0x7EE00000 SD — Derived from sdc_ctrl.h apb_id: 0x5344434F
0x7EE01000 L2 — Derived from l2_cache_ctrl.h apb_id: 0x4C324343
0x7EE02000 L1 — Derived from vpu_l1_cache_ctrl.h apb_id: 0x4C314343
0x7EE04000 VPU_ARB_CTRL — Derived from vpu_arb_ctrl.h
0x7EE05000 DMA15 — Derived from axi_dma15.h
0x7EE05000 DMA8 — Derived from axi_dma8.h
0x7EE06000 APHY_CSR — Derived from sdc_addr_front.h
0x7EE07000 DPHY_CSR — Derived from sdc_dq_front.h
0x7EE08000 APERF1 — Derived from axi_performance1.h apb_id: 0x41584950
0x7F000000 H264 — Derived from h264.h apb_id: 0x68323634
