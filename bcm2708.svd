# RasbperryPi register map
File version: 1
Registers are 32-bit, read-write, reset 0x0 unless marked. A register's access mark holds for its fields unless they carry their own. Offsets are from the block's base; [hi:lo] are bit positions; {n}, {i} and the like mark numbered series.

## A2W — Derived from cpr_apb2wtap.h password: 0x5A000000 apb_id: 0x00613277
Base 0x7E102000
0x00 PLLA_DIG0 24-bit
  [23:0] data
0x00 PLLA_CTRL 18-bit
  [17] PRSTN, [16] PWRDN, [15] _, [14:12] PDIV, [11:10] _, [9:0] NDIV
0x00 PLLA_FRAC 20-bit
0x00 PLLA_DSI0 10-bit
  [9] BYPEN, [8] CHENB, [7:0] DIV
0x00 PLLA_CORE 10-bit
  [9] BYPEN, [8] CHENB, [7:0] DIV
0x00 PLLA_PER 10-bit
  [9] BYPEN, [8] CHENB, [7:0] DIV
0x00 PLLA_CCP2 10-bit
  [9] BYPEN, [8] CHENB, [7:0] DIV
0x00 PLLA_DIG0R 24-bit
  [23:0] data
0x00 PLLA_CTRLR 18-bit
  [17:0] data
0x00 PLLA_FRACR 20-bit
  [19:0] data
0x00 PLLA_DSI0R 10-bit
  [9:0] data
0x00 PLLA_CORER 10-bit
  [9:0] data
0x00 PLLA_PERR 10-bit
  [9:0] data
0x00 PLLA_CCP2R 10-bit
  [9:0] data
0x00 PLLA_MULTI size not given
0x04 PLLA_DIG1 24-bit
  [23:0] data
0x04 PLLA_DIG1R 24-bit
  [23:0] data
0x08 PLLA_DIG2 24-bit reset 0x1
  [23:0] data
0x08 PLLA_DIG2R 24-bit reset 0x1
  [23:0] data
0x0C PLLA_DIG3 24-bit reset 0x4
  [23:0] data
0x0C PLLA_DIG3R 24-bit reset 0x4
  [23:0] data
{0x10+4i} PLLA_ANA{i} 24-bit (i=0..2)
  [23:0] data
0x10 PLLA_ANA_SSCS 17-bit
  [16] MODE, [15:0] STEP
0x10 PLLA_ANA_SSCL 22-bit
  [21:0] LIMIT
0x10 PLLA_ANA_KAIP 11-bit reset 0x3A
  [10:8] KA, [7] _, [6:4] KI, [3:0] KP
0x10 PLLA_ANA_STAT 12-bit
  [11:0] DATA
0x10 PLLA_ANA_SCTL 5-bit
  [4] RESET, [3] UPDATE, [2:0] SEL
0x10 PLLA_ANA_VCO 1-bit
  [0] RANGE
{0x10+4i} PLLA_ANA{i}R 24-bit (i=0..2)
  [23:0] data
0x10 PLLA_ANA_SSCSR 17-bit
  [16:0] data
0x10 PLLA_ANA_SSCLR 17-bit
  [16:0] data
0x10 PLLA_ANA_KAIPR 11-bit reset 0x3A
  [10:0] data
0x10 PLLA_ANA_STATR 12-bit
  [11:0] data
0x10 PLLA_ANA_SCTLR 5-bit
  [4:0] data
0x10 PLLA_ANA_VCOR 1-bit
  [0] data
0x10 PLLA_ANA_MULTI size not given
0x1C PLLA_ANA3 24-bit reset 0x80
  [23:0] data
0x1C PLLA_ANA3R 24-bit reset 0x80
  [23:0] data
0x20 PLLC_DIG0 24-bit
  [23:0] data
0x20 PLLC_CTRL 18-bit
  [17] PRSTN, [16] PWRDN, [15] _, [14:12] PDIV, [11:10] _, [9:0] NDIV
0x20 PLLC_FRAC 20-bit
0x20 PLLC_CORE{i} 10-bit (i=0..2)
  [9] BYPEN, [8] CHENB, [7:0] DIV
0x20 PLLC_PER 10-bit
  [9] BYPEN, [8] CHENB, [7:0] DIV
0x20 PLLC_DIG0R 24-bit
  [23:0] data
0x20 PLLC_CTRLR 18-bit
  [17:0] data
0x20 PLLC_FRACR 20-bit
  [19:0] data
0x20 PLLC_CORE{i}R 10-bit (i=0..2)
  [9:0] data
0x20 PLLC_PERR 10-bit
  [9:0] data
0x20 PLLC_MULTI size not given
0x24 PLLC_DIG1 24-bit
  [23:0] data
0x24 PLLC_DIG1R 24-bit
  [23:0] data
0x28 PLLC_DIG2 24-bit reset 0x1
  [23:0] data
0x28 PLLC_DIG2R 24-bit reset 0x1
  [23:0] data
0x2C PLLC_DIG3 24-bit reset 0x4
  [23:0] data
0x2C PLLC_DIG3R 24-bit reset 0x4
  [23:0] data
{0x30+4i} PLLC_ANA{i} 24-bit (i=0..2)
  [23:0] data
0x30 PLLC_ANA_SSCS 17-bit
  [16] MODE, [15:0] STEP
0x30 PLLC_ANA_SSCL 22-bit
  [21:0] data
0x30 PLLC_ANA_KAIP 11-bit reset 0x3A
  [10:8] KA, [7] _, [6:4] KI, [3:0] KP
0x30 PLLC_ANA_STAT 12-bit
  [11:0] DATA
0x30 PLLC_ANA_SCTL 5-bit
  [4] RESET, [3] UPDATE, [2:0] SEL
0x30 PLLC_ANA_VCO 1-bit
  [0] RANGE
{0x30+4i} PLLC_ANA{i}R 24-bit (i=0..2)
  [23:0] data
0x30 PLLC_ANA_SSCSR 17-bit
  [16:0] data
0x30 PLLC_ANA_SSCLR 17-bit
  [16:0] data
0x30 PLLC_ANA_KAIPR 11-bit reset 0x3A
  [10:0] data
0x30 PLLC_ANA_STATR 12-bit
  [11:0] data
0x30 PLLC_ANA_SCTLR 5-bit
  [4:0] data
0x30 PLLC_ANA_VCOR 1-bit
  [0] data
0x30 PLLC_ANA_MULTI size not given
0x3C PLLC_ANA3 24-bit reset 0x80
  [23:0] data
0x3C PLLC_ANA3R 24-bit reset 0x80
  [23:0] data
0x40 PLLD_DIG0 24-bit
  [23:0] data
0x40 PLLD_CTRL 18-bit
  [17] PRSTN, [16] PWRDN, [15] _, [14:12] PDIV, [11:10] _, [9:0] NDIV
0x40 PLLD_FRAC 20-bit
0x40 PLLD_DSI0 10-bit
  [9] BYPEN, [8] CHENB, [7:0] DIV
0x40 PLLD_CORE 10-bit
  [9] BYPEN, [8] CHENB, [7:0] DIV
0x40 PLLD_PER 10-bit
  [9] BYPEN, [8] CHENB, [7:0] DIV
0x40 PLLD_DSI1 10-bit
  [9] BYPEN, [8] CHENB, [7:0] DIV
0x40 PLLD_DIG0R 24-bit
  [23:0] data
0x40 PLLD_CTRLR 18-bit
  [17:0] data
0x40 PLLD_FRACR 20-bit
  [19:0] data
0x40 PLLD_DSI0R 10-bit
  [9:0] data
0x40 PLLD_CORER 10-bit
  [9:0] data
0x40 PLLD_PERR 10-bit
  [9:0] data
0x40 PLLD_DSI1R 10-bit
  [9:0] data
0x40 PLLD_MULTI size not given
0x44 PLLD_DIG1 24-bit
  [23:0] data
0x44 PLLD_DIG1R 24-bit
  [23:0] data
0x48 PLLD_DIG2 24-bit reset 0x1
  [23:0] data
0x48 PLLD_DIG2R 24-bit reset 0x1
  [23:0] data
0x4C PLLD_DIG3 24-bit reset 0x4
  [23:0] data
0x4C PLLD_DIG3R 24-bit reset 0x4
  [23:0] data
{0x50+4i} PLLD_ANA{i} 24-bit (i=0..2)
  [23:0] data
0x50 PLLD_ANA_SSCS 17-bit
  [16] MODE, [15:0] STEP
0x50 PLLD_ANA_SSCL 22-bit
  [21:0] data
0x50 PLLD_ANA_KAIP 11-bit reset 0x3A
  [10:8] KA, [7] _, [6:4] KI, [3:0] KP
0x50 PLLD_ANA_STAT 12-bit
  [11:0] DATA
0x50 PLLD_ANA_SCTL 5-bit
  [4] RESET, [3] UPDATE, [2:0] SEL
0x50 PLLD_ANA_VCO 1-bit
  [0] RANGE
{0x50+4i} PLLD_ANA{i}R 24-bit (i=0..2)
  [23:0] data
0x50 PLLD_ANA_SSCSR 17-bit
  [16:0] data
0x50 PLLD_ANA_SSCLR 17-bit
  [16:0] data
0x50 PLLD_ANA_KAIPR 11-bit reset 0x3A
  [10:0] data
0x50 PLLD_ANA_STATR 12-bit
  [11:0] data
0x50 PLLD_ANA_SCTLR 5-bit
  [4:0] data
0x50 PLLD_ANA_VCOR 1-bit
  [0] data
0x50 PLLD_ANA_MULTI size not given
0x5C PLLD_ANA3 24-bit reset 0x80
  [23:0] data
0x5C PLLD_ANA3R 24-bit reset 0x80
  [23:0] data
0x60 PLLH_DIG0 24-bit
  [23:0] data
0x60 PLLH_CTRL 18-bit
  [17] PRSTN, [16] PWRDN, [15] _, [14:12] PDIV, [11:8] _, [7:0] NDIV
0x60 PLLH_FRAC 20-bit
0x60 PLLH_AUX 10-bit
  [9] BYPEN, [8] CHENB, [7:0] DIV
0x60 PLLH_RCAL 10-bit
  [9] BYPEN, [8] CHENB, [7:0] DIV
0x60 PLLH_PIX 10-bit
  [9] BYPEN, [8] CHENB, [7:0] DIV
0x60 PLLH_ANA_STAT 21-bit
  [20] CNTLENB, [19:16] RCALCODE, [15:13] _, [12] RCALDONE, [11:0] DATA
0x60 PLLH_DIG0R 24-bit
  [23:0] data
0x60 PLLH_CTRLR 18-bit
  [17:0] data
0x60 PLLH_FRACR 20-bit
  [19:0] data
0x60 PLLH_AUXR 10-bit
  [9:0] data
0x60 PLLH_RCALR 10-bit
  [9:0] data
0x60 PLLH_PIXR 10-bit
  [9:0] data
0x60 PLLH_MULTI size not given
0x60 PLLH_ANA_STATR 21-bit
  [20:0] data
0x64 PLLH_DIG1 24-bit
  [23:0] data
0x64 PLLH_DIG1R 24-bit
  [23:0] data
0x68 PLLH_DIG2 24-bit reset 0xAA
  [23:0] data
0x68 PLLH_DIG2R 24-bit reset 0xAA
  [23:0] data
0x6C PLLH_DIG3 24-bit
  [23:0] data
0x6C PLLH_DIG3R 24-bit
  [23:0] data
0x70 PLLH_ANA0 24-bit
  [23:0] data
0x70 PLLH_ANA_KAIP 11-bit reset 0x3A
  [10:8] KA, [7] _, [6:4] KI, [3:0] KP
0x70 PLLH_ANA_SCTL 5-bit
  [4] RESET, [3] UPDATE, [2:0] SEL
0x70 PLLH_ANA_VCO 1-bit
  [0] RANGE
0x70 PLLH_ANA0R 24-bit
  [23:0] data
0x70 PLLH_ANA_KAIPR 11-bit reset 0x3A
  [10:0] data
0x70 PLLH_ANA_SCTLR 5-bit
  [4:0] data
0x70 PLLH_ANA_VCOR 1-bit
  [0] data
0x70 PLLH_ANA_MULTI size not given
0x74 PLLH_ANA1 24-bit reset 0x14
  [23:0] data
0x74 PLLH_ANA1R 24-bit reset 0x14
  [23:0] data
0x78 PLLH_ANA2 24-bit
  [23:0] data
0x78 PLLH_ANA2R 24-bit
  [23:0] data
0x7C PLLH_ANA3 24-bit
  [23:0] data
0x7C PLLH_ANA3R 24-bit
  [23:0] data
0x80 HDMI_CTL0 24-bit reset 0x38
  [23:0] data
0x80 HDMI_CTL_RCAL 17-bit
  [16] RSTB, [15:13] _, [12] MANREN, [11:8] MANR, [7:6] _, [5:4] SELDIV, [3:2] _, [1:0] SELAVG
0x80 HDMI_CTL_HFEN 1-bit
  [0] HFEN
0x80 HDMI_CTL0R 24-bit reset 0x38
  [23:0] data
0x80 HDMI_CTL_RCALR 17-bit
  [16:0] data
0x80 HDMI_CTL_HFENR 1-bit
  [0] data
0x80 HDMI_CTL_MULTI size not given
0x84 HDMI_CTL1 24-bit
  [23:0] data
0x84 HDMI_CTL1R 24-bit
  [23:0] data
0x88 HDMI_CTL2 24-bit reset 0x8E
  [23:0] data
0x88 HDMI_CTL2R 24-bit reset 0x8E
  [23:0] data
0x8C HDMI_CTL3 24-bit reset 0x40
  [23:0] data
0x8C HDMI_CTL3R 24-bit reset 0x40
  [23:0] data
0x90 XOSC0 24-bit reset 0x80
  [23:0] data
0x90 XOSC_CTRL 20-bit
  [19] PLLBOK, [18] PLLAOK, [17] PLLDOK, [16] DDROK, [15] SMPSOK, [14] USBOK, [13] HDMIOK, [12] PLLCOK, [11:8] _, [7] PLLBEN, [6] PLLAEN, [5] PLLDEN, [4] DDREN, [3] SMPSEN, [2] USBEN, [1] HDMIEN, [0] PLLCEN
0x90 XOSC_CPR 5-bit
  [4] CPR1, [3:2] _, [1:0] DIV
0x90 XOSC_BIAS 5-bit reset 0x18
  [4] HIGHP, [3:0] BIAS
0x90 XOSC_PWR 3-bit reset 0x4
  [2] RSTB, [1] PWRDN, [0] BYPASS
0x90 XOSC0R 24-bit reset 0x80
  [23:0] data
0x90 XOSC_CTRLR 8-bit
  [7:0] data
0x90 XOSC_CPRR 5-bit
  [4:0] data
0x90 XOSC_BIASR 5-bit reset 0x18
  [4:0] data
0x90 XOSC_PWRR 3-bit reset 0x4
  [2:0] data
0x90 XOSC_MULTI size not given
0x94 XOSC1 24-bit reset 0x6
  [23:0] data
0x94 XOSC1R 24-bit reset 0x6
  [23:0] data
{0xA0+4i} SMPS_CTLA{i} 24-bit (i=0..2)
  [23:0] data
0xA0 SMPS_A_MODE 1-bit
  [0] BSTPWMB
0xA0 SMPS_A_VOLTS 5-bit
0xA0 SMPS_A_GAIN 3-bit
  [2:0] DIGGAIN
{0xA0+4i} SMPS_CTLA{i}R 24-bit (i=0..2)
  [23:0] data
0xA0 SMPS_A_MODER 1-bit
  [0] data
0xA0 SMPS_A_VOLTSR 5-bit
  [4:0] data
0xA0 SMPS_A_GAINR 3-bit
  [2:0] data
0xA0 SMPS_A_MULTI size not given
{0xB0+4i} SMPS_CTLB{i} 24-bit (i=0..2)
  [23:0] data
0xB0 SMPS_B_STAT 13-bit
  [12] POK, [11:9] _, [8] BSTPWMB, [7:5] _, [4:0] VOLTS
{0xB0+4i} SMPS_CTLB{i}R 24-bit (i=0..2)
  [23:0] data
0xB0 SMPS_B_STATR 13-bit
  [12:0] data
0xB0 SMPS_B_MULTI size not given
{0xC0+4i} SMPS_CTLC{i} 24-bit (i=0..3)
  [23:0] data
0xC0 SMPS_C_CLK 4-bit
  [3] TDEN, [2] USEOSC, [1:0] OSCDIV
0xC0 SMPS_C_CTL 2-bit
  [1] UPEN, [0] CTRLEN
{0xC0+4i} SMPS_CTLC{i}R 24-bit (i=0..3)
  [23:0] data
0xC0 SMPS_C_CLKR 4-bit
  [3:0] data
0xC0 SMPS_C_CTLR 2-bit
  [1:0] data
0xC0 SMPS_C_MULTI size not given
0xD0 SMPS_LDO0 24-bit
  [23:0] data
0xD0 SMPS_L_SPV 5-bit
  [4:0] VOLTS
0xD0 SMPS_L_SPA 10-bit
  [9:0] ANA
0xD0 SMPS_L_SCV 5-bit
  [4:0] VOLTS
0xD0 SMPS_L_SCA 12-bit
  [11:0] ANA
0xD0 SMPS_L_SIV 5-bit
  [4:0] VOLTS
0xD0 SMPS_L_SIA 10-bit
  [9:0] ANA
0xD0 SMPS_LDO0R 24-bit
  [23:0] data
0xD0 SMPS_L_SPVR 5-bit
  [4:0] data
0xD0 SMPS_L_SPAR 10-bit
  [9:0] data
0xD0 SMPS_L_SCVR 5-bit
  [4:0] data
0xD0 SMPS_L_SCAR 12-bit
  [11:0] data
0xD0 SMPS_L_SIVR 5-bit
  [4:0] data
0xD0 SMPS_L_SIAR 10-bit
  [9:0] data
0xD0 SMPS_L_MULTI size not given
0xD4 SMPS_LDO1 24-bit
  [23:0] data
0xD4 SMPS_LDO1R 24-bit
  [23:0] data
0xE0 PLLB_DIG0 24-bit
  [23:0] data
0xE0 PLLB_CTRL 18-bit
  [17] PRSTN, [16] PWRDN, [15] _, [14:12] PDIV, [11:10] _, [9:0] NDIV
0xE0 PLLB_FRAC 20-bit
0xE0 PLLB_ARM 10-bit
  [9] BYPEN, [8] CHENB, [7:0] DIV
0xE0 PLLB_SP{i} 10-bit (i=0..2)
  [9] BYPEN, [8] CHENB, [7:0] DIV
0xE0 PLLB_DIG0R 24-bit
  [23:0] data
0xE0 PLLB_CTRLR 18-bit
  [17:0] data
0xE0 PLLB_FRACR 20-bit
  [19:0] data
0xE0 PLLB_ARMR 10-bit
  [9:0] data
0xE0 PLLB_SP{i}R 10-bit (i=0..2)
  [9:0] data
0xE0 PLLB_MULTI size not given
0xE4 PLLB_DIG1 24-bit
  [23:0] data
0xE4 PLLB_DIG1R 24-bit
  [23:0] data
0xE8 PLLB_DIG2 24-bit reset 0x1
  [23:0] data
0xE8 PLLB_DIG2R 24-bit reset 0x1
  [23:0] data
0xEC PLLB_DIG3 24-bit reset 0x4
  [23:0] data
0xEC PLLB_DIG3R 24-bit reset 0x4
  [23:0] data
{0xF0+4i} PLLB_ANA{i} 24-bit (i=0..2)
  [23:0] data
0xF0 PLLB_ANA_SSCS 17-bit
  [16] MODE, [15:0] STEP
0xF0 PLLB_ANA_SSCL 22-bit
  [21:0] LIMIT
0xF0 PLLB_ANA_KAIP 11-bit reset 0x3A
  [10:8] KA, [7] _, [6:4] KI, [3:0] KP
0xF0 PLLB_ANA_STAT 12-bit
  [11:0] DATA
0xF0 PLLB_ANA_SCTL 5-bit
  [4] RESET, [3] UPDATE, [2:0] SEL
0xF0 PLLB_ANA_VCO 1-bit
  [0] RANGE
{0xF0+4i} PLLB_ANA{i}R 24-bit (i=0..2)
  [23:0] data
0xF0 PLLB_ANA_SSCSR 17-bit
  [16:0] data
0xF0 PLLB_ANA_SSCLR 17-bit
  [16:0] data
0xF0 PLLB_ANA_KAIPR 11-bit reset 0x3A
  [10:0] data
0xF0 PLLB_ANA_STATR 12-bit
  [11:0] data
0xF0 PLLB_ANA_SCTLR 5-bit
  [4:0] data
0xF0 PLLB_ANA_VCOR 1-bit
  [0] data
0xF0 PLLB_ANA_MULTI size not given
0xFC PLLB_ANA3 24-bit reset 0x80
  [23:0] data
0xFC PLLB_ANA3R 24-bit reset 0x80
  [23:0] data

## A2W — Derived from cpr_apb2wtap_a0.h password: 0x5A000000 apb_id: 0x00613277
Base 0x7E102000
{0x0+4i} PLLA_DIG{i} 24-bit (i=0..3)
  [23:0] data
0x00 PLLA_CTRL 18-bit
  [17] PRSTN, [16] PWRDN, [15] _, [14:12] PDIV, [11:10] _, [9:0] NDIV
0x00 PLLA_FRAC 20-bit
0x00 PLLA_DSI0 10-bit
  [9] BYPEN, [8] CHENB, [7:0] DIV
0x00 PLLA_CORE 10-bit
  [9] BYPEN, [8] CHENB, [7:0] DIV
0x00 PLLA_PER 10-bit
  [9] BYPEN, [8] CHENB, [7:0] DIV
0x00 PLLA_CCP2 10-bit
  [9] BYPEN, [8] CHENB, [7:0] DIV
{0x0+4i} PLLA_DIG{i}R 24-bit (i=0..3)
  [23:0] data
0x00 PLLA_CTRLR 18-bit
  [17:0] data
0x00 PLLA_FRACR 20-bit
  [19:0] data
0x00 PLLA_DSI0R 10-bit
  [9:0] data
0x00 PLLA_CORER 10-bit
  [9:0] data
0x00 PLLA_PERR 10-bit
  [9:0] data
0x00 PLLA_CCP2R 10-bit
  [9:0] data
0x00 PLLA_MULTI size not given
{0x10+4i} PLLA_ANA{i} 24-bit (i=0..3)
  [23:0] data
{0x10+4i} PLLA_ANA{i}R 24-bit (i=0..3)
  [23:0] data
{0x20+4i} PLLC_DIG{i} 24-bit (i=0..3)
  [23:0] data
0x20 PLLC_CTRL 18-bit
  [17] PRSTN, [16] PWRDN, [15] _, [14:12] PDIV, [11:10] _, [9:0] NDIV
0x20 PLLC_FRAC 20-bit
0x20 PLLC_CORE{i} 10-bit (i=0..2)
  [9] BYPEN, [8] CHENB, [7:0] DIV
0x20 PLLC_PER 10-bit
  [9] BYPEN, [8] CHENB, [7:0] DIV
{0x20+4i} PLLC_DIG{i}R 24-bit (i=0..3)
  [23:0] data
0x20 PLLC_CTRLR 18-bit
  [17:0] data
0x20 PLLC_FRACR 20-bit
  [19:0] data
0x20 PLLC_CORE{i}R 10-bit (i=0..2)
  [9:0] data
0x20 PLLC_PERR 10-bit
  [9:0] data
0x20 PLLC_MULTI size not given
{0x30+4i} PLLC_ANA{i} 24-bit (i=0..3)
  [23:0] data
{0x30+4i} PLLC_ANA{i}R 24-bit (i=0..3)
  [23:0] data
{0x40+4i} PLLD_DIG{i} 24-bit (i=0..3)
  [23:0] data
0x40 PLLD_CTRL 18-bit
  [17] PRSTN, [16] PWRDN, [15] _, [14:12] PDIV, [11:10] _, [9:0] NDIV
0x40 PLLD_FRAC 20-bit
0x40 PLLD_DSI0 10-bit
  [9] BYPEN, [8] CHENB, [7:0] DIV
0x40 PLLD_CORE 10-bit
  [9] BYPEN, [8] CHENB, [7:0] DIV
0x40 PLLD_PER 10-bit
  [9] BYPEN, [8] CHENB, [7:0] DIV
0x40 PLLD_DSI1 10-bit
  [9] BYPEN, [8] CHENB, [7:0] DIV
{0x40+4i} PLLD_DIG{i}R 24-bit (i=0..3)
  [23:0] data
0x40 PLLD_CTRLR 18-bit
  [17:0] data
0x40 PLLD_FRACR 20-bit
  [19:0] data
0x40 PLLD_DSI0R 10-bit
  [9:0] data
0x40 PLLD_CORER 10-bit
  [9:0] data
0x40 PLLD_PERR 10-bit
  [9:0] data
0x40 PLLD_DSI1R 10-bit
  [9:0] data
0x40 PLLD_MULTI size not given
{0x50+4i} PLLD_ANA{i} 24-bit (i=0..3)
  [23:0] data
{0x50+4i} PLLD_ANA{i}R 24-bit (i=0..3)
  [23:0] data
{0x60+4i} PLLH_DIG{i} 24-bit (i=0..3)
  [23:0] data
0x60 PLLH_CTRL 18-bit
  [17] PRSTN, [16] PWRDN, [15] _, [14:12] PDIV, [11:8] _, [7:0] NDIV
0x60 PLLH_FRAC 20-bit
0x60 PLLH_AUX 10-bit
  [9] BYPEN, [8] CHENB, [7:0] DIV
0x60 PLLH_RCAL 10-bit
  [9] BYPEN, [8] CHENB, [7:0] DIV
0x60 PLLH_PIX 10-bit
  [9] BYPEN, [8] CHENB, [7:0] DIV
0x60 PLLH_STS
  [31:0] data
{0x60+4i} PLLH_DIG{i}R 24-bit (i=0..3)
  [23:0] data
0x60 PLLH_CTRLR 18-bit
  [17:0] data
0x60 PLLH_FRACR 20-bit
  [19:0] data
0x60 PLLH_AUXR 10-bit
  [9:0] data
0x60 PLLH_RCALR 10-bit
  [9:0] data
0x60 PLLH_PIXR 10-bit
  [9:0] data
0x60 PLLH_STSR
  [31:0] data
0x60 PLLH_MULTI size not given
{0x70+4i} PLLH_ANA{i} 24-bit (i=0..3)
  [23:0] data
{0x70+4i} PLLH_ANA{i}R 24-bit (i=0..3)
  [23:0] data
{0x80+4i} HDMI_CTL{i} 24-bit (i=0..3)
  [23:0] data
{0x80+4i} HDMI_CTL{i}R 24-bit (i=0..3)
  [23:0] data
0x90 XOSC0 24-bit
  [23:0] data
0x90 XOSC_CTRL 10-bit
  [9:8] DIV, [7] _, [6] PLLAEN, [5] PLLDEN, [4] DDREN, [3] CPR1EN, [2] USBEN, [1] HDMIEN, [0] PLLCEN
0x90 XOSC0R 24-bit
  [23:0] data
0x90 XOSC_CTRLR 10-bit
  [9:0] data
0x94 XOSC1 24-bit
  [23:0] data
0x94 XOSC1R 24-bit
  [23:0] data
{0xA0+4i} SMPS_CTLA{i} 24-bit (i=0..2)
  [23:0] data
{0xA0+4i} SMPS_CTLA{i}R 24-bit (i=0..2)
  [23:0] data
{0xB0+4i} SMPS_CTLB{i} 24-bit (i=0..2)
  [23:0] data
{0xB0+4i} SMPS_CTLB{i}R 24-bit (i=0..2)
  [23:0] data
{0xC0+4i} SMPS_CTLC{i} 24-bit (i=0..3)
  [23:0] data
{0xC0+4i} SMPS_CTLC{i}R 24-bit (i=0..3)
  [23:0] data
0xD0 SMPS_LDO0 24-bit
  [23:0] data
0xD0 SMPS_LDO0R 24-bit
  [23:0] data
0xD4 SMPS_LDO1 24-bit
  [23:0] data
0xD4 SMPS_LDO1R 24-bit
  [23:0] data
