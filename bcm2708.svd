# RasbperryPi register map
File version: 1
Registers are 32-bit, read-write, reset 0x0 unless marked. A register's access mark holds for its fields unless they carry their own. Offsets are from the block's base; [hi:lo] are bit positions; {n}, {i} and the like mark numbered series; 'fields as' and 'values as' point back to an identical list.

## PM — Derived from cpr_powman.h password: 0x5A000000 apb_id: 0x0000706D
Base 0x7E100000
0x00 GNRIC 23-bit
  [22:16] CFG, [15:13] _, [12] ENAB, [11:6] RSTN, [5] ISFUNC, [4] MRDONE, [3] MEMREP, [2] ISPOW, [1] POWOK, [0] POWUP
0x04 AUDIO 22-bit reset 0xFF
  [21] RSTN, [20] CTRLEN, [19:0] APSM
0x08 IMAGE 23-bit
  [22:16] CFG, [15:13] _, [12] ENAB, [11:9] _, [8] ISPRSTN, [7] H264RSTN, [6] PERIRSTN, [5] ISFUNC, [4] MRDONE, [3] MEMREP, [2] ISPOW, [1] POWOK, [0] POWUP
0x0C GRAFX 23-bit
  [22:16] CFG, [15:13] _, [12] ENAB, [11:7] _, [6] V3DRSTN, [5] ISFUNC, [4] MRDONE, [3] MEMREP, [2] ISPOW, [1] POWOK, [0] POWUP
0x10 PROC 23-bit
  [22:16] CFG, [15:13] _, [12] ENAB, [11:7] _, [6] ARMRSTN, [5] ISFUNC, [4] MRDONE, [3] MEMREP, [2] ISPOW, [1] POWOK, [0] POWUP
0x18 STATUS 24-bit ro
  [23:0] data
0x1C RSTC 22-bit reset 0x2
  [21:20] HRCFG, [19:18] _, [17:16] FRCFG, [15:14] _, [13:12] QRCFG, [11:10] _, [9:8] SRCFG, [7:6] _, [5:4] WRCFG, [3:2] _, [1:0] DRCFG
0x20 RSTS 13-bit
  [12] HADPOR, [11] _, [10] HADSRH, [9] HADSRF, [8] HADSRQ, [7] _, [6] HADWRH, [5] HADWRF, [4] HADWRQ, [3] _, [2] HADDRH, [1] HADDRF, [0] HADDRQ
0x24 WDOG 20-bit
  [19:0] TIME
0x28 PADS0 6-bit reset 0x1B
  [5] POWOK, [4] SLEW, [3] HYST, [2:0] DRIVE
0x2C PADS2 6-bit reset 0x1B
  [5] POWOK, [4] SLEW, [3] HYST, [2:0] DRIVE
0x30 PADS3 6-bit reset 0x1B
  [5] POWOK, [4] SLEW, [3] HYST, [2:0] DRIVE
0x34 PADS4 6-bit reset 0x1B
  [5] POWOK, [4] SPARE, [3] HYST, [2:0] DRIVE
0x38 PADS5 7-bit reset 0x1B
  [6] I2CMODE, [5] POWOK, [4] SLEW, [3] HYST, [2:0] DRIVE
0x3C PADS6 9-bit
  [8] PD, [7:6] _, [5] POWOK, [4:2] _, [1:0] DRIVE
0x44 CAM0 21-bit
  [20:3] LDOCTRL, [2] LDOHPEN, [1] LDOLPEN, [0] CTRLEN
0x48 CAM1 21-bit
  [20:3] LDOCTRL, [2] LDOHPEN, [1] LDOLPEN, [0] CTRLEN
0x4C CCP2TX 19-bit
  [18:2] LDOCTRL, [1] LDOEN, [0] CTRLEN
0x50 DSI0 21-bit
  [20:3] LDOCTRL, [2] LDOHPEN, [1] LDOLPEN, [0] CTRLEN
0x54 DSI1 21-bit
  [20:3] LDOCTRL, [2] LDOHPEN, [1] LDOLPEN, [0] CTRLEN
0x58 HDMI 20-bit reset 0x2
  [19] RSTDR, [18:2] LDOCTRL, [1] LDOPD, [0] CTRLEN
0x5C USB 1-bit
  [0] CTRLEN
0x60 PXLDO 18-bit
  [17] RSTPLLDR, [16] RSTOSCDR, [15:0] CTRL
0x64 PXBG 16-bit
  [15:0] CTRL
0x68 DFT 2-bit
  [1] STOPALLCLOCKS, [0] ALLOWAUDIOCKSTOP
0x6C SMPS 3-bit
  [2] UPEN, [1] RSTDR, [0] CTRLEN
0x70 XOSC 1-bit
  [0] USESEC
0x74 SPAREW 24-bit
  [23:0] SPARE
0x78 SPARER 24-bit ro
  [23:0] SPARE
0x7C AVS_RSTDR 6-bit
  [5] ROSC, [4] ARM_P, [3] V3D_G, [2] H264_I, [1] SYSTEM_A, [0] PERI_A
0x80 AVS_STAT 5-bit
  [4] ALERT_ARM_P, [3] ALERT_V3D_G, [2] ALERT_H264_I, [1] ALERT_SYSTEM_A, [0] ALERT_PERI_A
0x84 AVS_EVENT 5-bit
  fields as AVS_STAT
0x88 AVS_INTEN 5-bit
  fields as AVS_STAT
0xFC DUMMY 1-bit ro reset 0x1
  [0] ONE

## PM — Derived from cpr_powman_a0.h password: 0x5A000000 apb_id: 0x0000706D
Base 0x7E100000
0x00 GNRIC 23-bit
  [22:16] CFG, [15:12] _, [11:6] RSTN, [5] ISFUNC, [4] MRDONE, [3] MEMREP, [2] ISPOW, [1] POWOK, [0] POWUP
0x04 AUDIO 17-bit
  [16] RSTN, [15:9] _, [8] CTRLEN, [7:0] APSM
0x08 OLDIMAGE 23-bit
  [22:16] CFG, [15:7] _, [6] ISPRSTN, [5] H264RSTN, [4] PERIRSTN, [3] ISFUNC, [2] ISPOW, [1] POWOK, [0] POWUP
0x08 IMAGE 23-bit
  [22:16] CFG, [15:9] _, [8] ISPRSTN, [7] H264RSTN, [6] PERIRSTN, [5] ISFUNC, [4] MRDONE, [3] MEMREP, [2] ISPOW, [1] POWOK, [0] POWUP
0x0C OLDGRAFX 23-bit
  [22:16] CFG, [15:8] _, [7] V3DRSTN, [6:4] _, [3] ISFUNC, [2] ISPOW, [1] POWOK, [0] POWUP
0x0C GRAFX 23-bit
  [22:16] CFG, [15:7] _, [6] V3DRSTN, [5] ISFUNC, [4] MRDONE, [3] MEMREP, [2] ISPOW, [1] POWOK, [0] POWUP
0x10 PROC 23-bit
  fields as PROC
0x10 OTPPOR 24-bit
  [23:0] KEY
0x14 AUDIOPOR 24-bit
  [23:0] KEY
0x18 POR 11-bit ro
  [10:0] STATUS
0x1C RSTC 22-bit reset 0x2
  fields as RSTC
0x20 RSTS 13-bit
  fields as RSTS
0x24 WDOG 12-bit
  [11:0] TIME
0x28 PADS0 6-bit reset 0x1B
  [5] POWOK, [4] SLEW, [3] HYST, [2:0] DRIVE
{0x24+4i} PADS{i} 6-bit reset 0x1B (i=2..4)
  [5] POWOK, [4] SLEW, [3] HYST, [2:0] DRIVE
0x38 PADS5 7-bit reset 0x1B
  [6] I2CMODE, [5] POWOK, [4] SLEW, [3] HYST, [2:0] DRIVE
0x3C PADS6 6-bit
  [5] POWOK, [4:2] _, [1:0] DRIVE
0x40 MEMS 1-bit
  [0] LOWVOLT
0x44 CAM0 21-bit
  [20:3] LDOCTRL, [2] LDOHPEN, [1] LDOLPEN, [0] CTRLEN
0x48 CAM1 21-bit
  [20:3] LDOCTRL, [2] LDOHPEN, [1] LDOLPEN, [0] CTRLEN
0x4C CCP2TX 19-bit
  [18:2] LDOCTRL, [1] LDOEN, [0] CTRLEN
0x50 DSI0 21-bit
  [20:3] LDOCTRL, [2] LDOHPEN, [1] LDOLPEN, [0] CTRLEN
0x54 DSI1 21-bit
  [20:3] LDOCTRL, [2] LDOHPEN, [1] LDOLPEN, [0] CTRLEN
0x58 HDMI 20-bit reset 0x2
  [19] RSTDR, [18:2] LDOCTRL, [1] LDOPD, [0] CTRLEN
0x5C USB 1-bit
  [0] CTRLEN
0x60 PXLDO 18-bit
  [17] RSTPLLDR, [16] RSTOSCDR, [15:0] CTRL
0x64 PXBG 16-bit
  [15:0] CTRL
0x68 DFT 2-bit
  [1] STOPALLCLOCKS, [0] ALLOWAUDIOCKSTOP
0x6C SMPS 3-bit
  [2] UPEN, [1] RSTDR, [0] CTRLEN
0x70 XOSC 1-bit
  [0] USESEC
0x74 SPAREW 24-bit
  [23:0] SPARE
0x78 SPARER 24-bit ro
  [23:0] SPARE
0xFC DUMMY 1-bit ro reset 0x1
  [0] ONE
